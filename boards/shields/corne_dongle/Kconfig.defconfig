## boards/shields/corne_dongle/Kconfig.defconfig
```kconfig
if SHIELD_CORNE_DONGLE

config ZMK_KEYBOARD_NAME
    default "CorneKBH"

config ZMK_SPLIT_ROLE_CENTRAL
    default y

config ZMK_SPLIT
    default y

# Keep USB HID enabled without the studio-rpc-usb-uart snippet, so the dongle
# still works as a plain USB keyboard through a KVM.
config ZMK_USB
    default y

# Left + right halves = 2 peripherals
config ZMK_SPLIT_BLE_CENTRAL_PERIPHERALS
    default 2

# Peripherals (2) + desired BT profiles (5)
config BT_MAX_CONN
    default 7

# Same value as BT_MAX_CONN
config BT_MAX_PAIRED
    default 7

endif
```
